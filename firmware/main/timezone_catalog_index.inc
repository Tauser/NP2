/* Generated by tools/generate_timezone_index.py; do not reorder zones.
 * CSV SHA256: 761a0cfee1da4767007978594e1673284a7f36fd105fa597f71bb34bffdc6d91
 * Country metadata: IANA 2026b, public domain; POSIX rules unchanged. */
static const uint16_t s_catalog_offsets[] = {
    0, 24, 46, 75, 100, 124, 147, 171, 194, 217, 243, 272,
    299, 346, 376, 420, 444, 466, 497, 523, 547, 575, 600, 626,
    650, 681, 703, 728, 754, 778, 804, 827, 855, 876, 900, 928,
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    15100,
};
static const char *const s_country_names[] = {
    "",
    "Afghanistan",
    "Albania",
    "Alemanha",
    "Algeria",
    "Andorra",
    "Angola",
    "Anguilla",
    "Antarctica",
    "Antigua & Barbuda",
    "Argentina",
    "Armenia",
    "Aruba",
    "Austria",
    "Austrália",
    "Azerbaijan",
    "Bahamas",
    "Bahrain",
    "Bangladesh",
    "Barbados",
    "Belarus",
    "Belgium",
    "Belize",
    "Benin",
    "Bermuda",
    "Bhutan",
    "Bolivia",
    "Bosnia & Herzegovina",
    "Botswana",
    "Brasil",
    "British Indian Ocean Territory",
    "Brunei",
    "Bulgaria",
    "Burkina Faso",
    "Burundi",
    "Cambodia",
    "Cameroon",
    "Canadá",
    "Cape Verde",
    "Caribbean NL",
    "Cayman Islands",
    "Central African Rep.",
    "Chad",
    "Chile",
    "China",
    "Christmas Island",
    "Cocos (Keeling) Islands",
    "Colombia",
    "Comoros",
    "Congo (Dem. Rep.)",
    "Congo (Rep.)",
    "Cook Islands",
    "Costa Rica",
    "Croatia",
    "Cuba",
    "Curaçao",
    "Cyprus",
    "Czech Republic",
    "Côte d'Ivoire",
    "Denmark",
    "Djibouti",
    "Dominica",
    "Dominican Republic",
    "East Timor",
    "Ecuador",
    "Egypt",
    "El Salvador",
    "Equatorial Guinea",
    "Eritrea",
    "Espanha",
    "Estados Unidos",
    "Estonia",
    "Eswatini (Swaziland)",
    "Ethiopia",
    "Falkland Islands",
    "Faroe Islands",
    "Fiji",
    "Finland",
    "França",
    "French Guiana",
    "French Polynesia",
    "French S. Terr.",
    "Gabon",
    "Gambia",
    "Georgia",
    "Ghana",
    "Gibraltar",
    "Greece",
    "Greenland",
    "Grenada",
    "Guadeloupe",
    "Guam",
    "Guatemala",
    "Guernsey",
    "Guinea",
    "Guinea-Bissau",
    "Guyana",
    "Haiti",
    "Honduras",
    "Hong Kong",
    "Hungary",
    "Iceland",
    "Indonesia",
    "Iran",
    "Iraq",
    "Ireland",
    "Isle of Man",
    "Israel",
    "Itália",
    "Jamaica",
    "Japão",
    "Jersey",
    "Jordan",
    "Kazakhstan",
    "Kenya",
    "Kiribati",
    "Korea (North)",
    "Korea (South)",
    "Kuwait",
    "Kyrgyzstan",
    "Laos",
    "Latvia",
    "Lebanon",
    "Lesotho",
    "Liberia",
    "Libya",
    "Liechtenstein",
    "Lithuania",
    "Luxembourg",
    "Macau",
    "Madagascar",
    "Malawi",
    "Malaysia",
    "Maldives",
    "Mali",
    "Malta",
    "Marshall Islands",
    "Martinique",
    "Mauritania",
    "Mauritius",
    "Mayotte",
    "Micronesia",
    "Moldova",
    "Monaco",
    "Mongolia",
    "Montenegro",
    "Montserrat",
    "Morocco",
    "Mozambique",
    "Myanmar (Burma)",
    "México",
    "Namibia",
    "Nauru",
    "Nepal",
    "Netherlands",
    "New Caledonia",
    "Nicaragua",
    "Niger",
    "Nigeria",
    "Niue",
    "Norfolk Island",
    "North Macedonia",
    "Northern Mariana Islands",
    "Norway",
    "Nova Zelândia",
    "Oman",
    "Pakistan",
    "Palau",
    "Palestine",
    "Panama",
    "Papua New Guinea",
    "Paraguay",
    "Peru",
    "Philippines",
    "Pitcairn",
    "Poland",
    "Portugal",
    "Puerto Rico",
    "Qatar",
    "Reino Unido",
    "Romania",
    "Rwanda",
    "Réunion",
    "Rússia",
    "Samoa (American)",
    "Samoa (western)",
    "San Marino",
    "Sao Tome & Principe",
    "Saudi Arabia",
    "Senegal",
    "Serbia",
    "Seychelles",
    "Sierra Leone",
    "Singapore",
    "Slovakia",
    "Slovenia",
    "Solomon Islands",
    "Somalia",
    "South Georgia & the South Sandwich Islands",
    "South Sudan",
    "Sri Lanka",
    "St Barthelemy",
    "St Helena",
    "St Kitts & Nevis",
    "St Lucia",
    "St Maarten (Dutch)",
    "St Martin (French)",
    "St Pierre & Miquelon",
    "St Vincent",
    "Sudan",
    "Suriname",
    "Svalbard & Jan Mayen",
    "Sweden",
    "Switzerland",
    "Syria",
    "Taiwan",
    "Tajikistan",
    "Tanzania",
    "Thailand",
    "Togo",
    "Tokelau",
    "Tonga",
    "Trinidad & Tobago",
    "Tunisia",
    "Turkey",
    "Turkmenistan",
    "Turks & Caicos Is",
    "Tuvalu",
    "US minor outlying islands",
    "Uganda",
    "Ukraine",
    "United Arab Emirates",
    "Uruguai",
    "Uzbekistan",
    "Vanuatu",
    "Vatican City",
    "Venezuela",
    "Vietnam",
    "Virgin Islands (UK)",
    "Virgin Islands (US)",
    "Wallis & Futuna",
    "Western Sahara",
    "Yemen",
    "Zambia",
    "Zimbabwe",
    "África do Sul",
    "Åland Islands",
    "Índia",
};
static const uint8_t s_country_ids[TIMEZONE_CATALOG_COUNT] = {
    29, 29, 10, 70, 179, 58, 85, 73, 4, 68, 134, 41, 83, 95, 131, 50,
    34, 65, 147, 69, 94, 189, 217, 60, 36, 241, 192, 28, 244, 245, 199, 229,
    209, 181, 49, 158, 82, 219, 6, 49, 243, 67, 148, 123, 72, 197, 124, 114,
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    0, 0, 0, 0, 0, 0, 0, 0, 0, 0, 0, 0, 0, 0,
};
